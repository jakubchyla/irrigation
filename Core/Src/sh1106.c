#include "sh1106.h"
#include <stdint.h>
#include <string.h>
#include "stm32l4xx_hal.h"
#include "stm32l4xx_hal_def.h"
#include "stm32l4xx_hal_i2c.h"

struct SH1106_DATA_t SH1106_CONFIG;

// 128 x 64 display
// 128 column, 8 pages
uint8_t SH1106_BUFFER[128 * 8];
uint16_t SH1106_BUFFER_SIZE = 128 * 8;

static const uint16_t FONT_7x10 [] = {
0x0000, 0x0000, 0x0000, 0x0000, 0x0000, 0x0000, 0x0000, 0x0000, 0x0000, 0x0000,  // sp
0x1000, 0x1000, 0x1000, 0x1000, 0x1000, 0x1000, 0x0000, 0x1000, 0x0000, 0x0000,  // !
0x2800, 0x2800, 0x2800, 0x0000, 0x0000, 0x0000, 0x0000, 0x0000, 0x0000, 0x0000,  // "
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0x0000, 0x0000, 0x0000, 0x7400, 0x4C00, 0x0000, 0x0000, 0x0000, 0x0000, 0x0000,  // ~
};

const struct SH1106_FONT_T SH1106_FONT = {7, 10, FONT_7x10};

void sh1106_write_command_buf(uint8_t *data, uint8_t buf_size)
{
    HAL_I2C_Mem_Write(SH1106_CONFIG.i2c_handle, (0x3C << 1), 0, 1, data, buf_size, HAL_MAX_DELAY);
}
void sh1106_write_command(uint8_t data)
{
    sh1106_write_command_buf(&data, 1);
}

void sh1106_write_data(uint8_t *data_buffer, uint16_t data_buffer_size)
{
    HAL_I2C_Mem_Write(SH1106_CONFIG.i2c_handle, (0x3C << 1), 0x40, 1, data_buffer, data_buffer_size, HAL_MAX_DELAY);
}

void sh1106_draw_pixel(uint16_t x, uint16_t y, enum SH1106_COLOR color)
{
    if (x > SH1106_WIDTH || y > SH1106_HEIGHT)
    {
        return;
    }
    if (color == WHITE)
    {
        SH1106_BUFFER[x + (y / 8) * SH1106_WIDTH] |= 1 << (y % 8);
    }
    else
    {
        SH1106_BUFFER[x + (y / 8) * SH1106_WIDTH] &= ~(1 << (y % 8));
    }
}

uint8_t sh1106_write_char(char c, struct SH1106_FONT_T font, enum SH1106_COLOR color)
{
    if (c < 0x20 || c > 0x7E)
    {
        return 1;
    }
    if ((SH1106_CONFIG.x + font.width) > SH1106_WIDTH || (SH1106_CONFIG.y + font.height) > SH1106_HEIGHT)
    {
        return 1;
    }
    uint16_t char_start_index = (c - 0x20) * font.height;

    for (uint8_t i = 0; i < font.height; i++)
    {
        uint16_t row_data = font.data[char_start_index + i];
        for (uint8_t j = 0; j < font.width; j++)
        {
            if (row_data & (1 << (15 - j)))
            {
                sh1106_draw_pixel(SH1106_CONFIG.x + j, SH1106_CONFIG.y + i, color);
            }
        }
    }
    SH1106_CONFIG.x = SH1106_CONFIG.x + font.width;
    return 0;
}

uint8_t sh1106_write_string(char *str, struct SH1106_FONT_T font, enum SH1106_COLOR color)
{
    char *tmp_str = str;
    while(*tmp_str)
    {
        if (sh1106_write_char(*tmp_str, font, color))
        {
            // failed to write char
            return 1;
        }
        tmp_str++;
    }
    return 0;
}

void sh1106_set_cursor(uint8_t x, uint8_t y)
{
    SH1106_CONFIG.x = x;
    SH1106_CONFIG.y = y;
}

void sh1106_update_screen()
{
    // page addressing, 128 bytes chunks
    for (uint8_t i = 0; i < SH1106_HEIGHT / 8; i++)
    {
        sh1106_write_command(0xB0 + i);
        sh1106_write_command(0x02);
        sh1106_write_command(0x10);

        sh1106_write_data(SH1106_BUFFER + (128 * i), 128);
    }
}

void sh1106_set_state(enum SH1106_STATE state)
{
    // 0 - off
    // 1 - on
    // else - skip
    if (state == ON)
    {
        sh1106_write_command(0xAF);
    }
    if (state == OFF)
    {
        sh1106_write_command(0xAE);
    }
}

void sh1106_fill_screen(enum SH1106_COLOR color)
{
    uint8_t fill_color;
    if (color == BLACK)
    {
        fill_color = 0;
    }
    else
    {
        fill_color = 0xFF;
    }
    memset(SH1106_BUFFER, fill_color, SH1106_BUFFER_SIZE);
}


void sh1106_init(I2C_HandleTypeDef *i2c_handle)
{
    SH1106_CONFIG.i2c_handle = i2c_handle;
    uint8_t commands_buffer[3];
    // multiplex ratio
    commands_buffer[0] = 0xA8;
    commands_buffer[1] = 0x3F;
    sh1106_write_command_buf(commands_buffer, 2);

    // COM pin hardware configuration
    commands_buffer[0] = 0xDA;
    commands_buffer[1] = 0x12;
    sh1106_write_command_buf(commands_buffer, 2);

    // 0x40 - data address
    sh1106_write_command(0x40);

    // COM output scan direction
    // normal mode
    sh1106_write_command(0xC0);

    // addressing mode
    // page addressing
    commands_buffer[0] = 0x20;
    commands_buffer[1] = 0x02;
    sh1106_write_command_buf(commands_buffer, 2);

    // column start and end address 0 - 127
    commands_buffer[0] = 0x21;
    commands_buffer[1] = 0x00;
    commands_buffer[2] = 0x7F; // 127
    sh1106_write_command_buf(commands_buffer, 3);

    // page start and end address 0 - 64
    commands_buffer[0] = 0x22;
    commands_buffer[1] = 0x00;
    commands_buffer[2] = 0x07;
    sh1106_write_command_buf(commands_buffer, 3);

    // set contrast
    // contrast 50%
    commands_buffer[0] = 0x81;
    commands_buffer[1] = 0x7F;
    sh1106_write_command_buf(commands_buffer, 2);

    // read from RAM
    sh1106_write_command(0xA4);

    // enable charge pump
    commands_buffer[0] = 0x8D;
    commands_buffer[1] = 0x14;
    sh1106_write_command_buf(commands_buffer, 2);

    // change refresh rate
    commands_buffer[0] = 0xD5;
    commands_buffer[1] = 0xF0;
    sh1106_write_command_buf(commands_buffer, 2);

    // set pre-charge
    commands_buffer[0] = 0xD9;
    commands_buffer[1] = 0x22;
    sh1106_write_command_buf(commands_buffer, 2);

    // set VCOMH deselect level
    commands_buffer[0] = 0xDB;
    commands_buffer[1] = 0x30;
    sh1106_write_command_buf(commands_buffer, 2);

    sh1106_fill_screen(BLACK);
    sh1106_set_state(ON);
    sh1106_update_screen();
}

